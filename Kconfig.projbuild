## main/Kconfig.projbuild
```kconfig
menu "Kitchen LED Controller"

    choice KLC_BOARD
        prompt "Board profile"
        default KLC_BOARD_ESP32_WROOM_32D
        help
            Select the hardware board. Each choice documents pin and peripheral
            constraints for that module. The IDF_TARGET cmake variable must
            match the selected board; cmake will reject mismatches.

        config KLC_BOARD_ESP32_WROOM_32D
            bool "ESP32-WROOM-32D"
        config KLC_BOARD_ESP32_S3
            bool "ESP32-S3 (placeholder — not production-ready)"
        config KLC_BOARD_ESP32_C6
            bool "ESP32-C6 (placeholder — not production-ready)"
    endchoice

    config KLC_LED_PWM_GPIO
        int "LED PWM output GPIO"
        range 0 48
        default 18
        help
            GPIO driving the external MOSFET gate. Must be output-capable and
            must not be a strapping pin on the selected board.
            WROOM-32D safe choices: 13, 14, 16, 17, 18, 19, 21-23, 25-27,
            32, 33. GPIOs 34-39 are input-only on ESP32 and are rejected at
            configure time. The final pin must be confirmed from the schematic
            before PCB release. This value is not a credential.

    config KLC_LED_PWM_FREQUENCY_HZ
        int "LED PWM frequency (Hz)"
        range 1000 9765
        default 8000
        help
            PWM carrier frequency driving the MOSFET. Must be confirmed with
            the actual MOSFET switching characteristics to avoid audible noise
            or excessive switching loss.
            Constraint: the ESP HAL PWM backend (hal_pwm_esp.c) runs LEDC at
            a fixed 13-bit duty resolution, so
            frequency * 2^13 must not exceed the 80 000 000 Hz APB clock.
            CMake rejects invalid values at configure time; the practical
            maximum is 9765 Hz (8000 Hz by default keeps divider margin).

    config KLC_LED_PWM_RESOLUTION_BITS
        int "LED PWM duty resolution (bits)"
        range 8 15
        default 13
        help
            Duty-cycle resolution requested by the product layer. The ESP HAL
            PWM backend (hal_pwm_esp.c) runs LEDC at a fixed 13-bit duty
            resolution regardless of this value, so 13 is the only value that
            matches the hardware backend; keep it at 13.
            Constraint: frequency * 2^13 must not exceed 80 000 000 (ESP32
            APB clock); see KLC_LED_PWM_FREQUENCY_HZ. CMake validates the
            combined budget at configure time.

    config KLC_LED_PWM_ACTIVE_LOW
        bool "LED output is active-low"
        default n
        help
            Enable when the power stage drives the LED off at logic-high and
            on at logic-low. The OSAL PWM backend inverts the duty cycle when
            this option is set.

    config KLC_DEFAULT_BRIGHTNESS_PERCENT
        int "Default brightness after state synchronization (%)"
        range 0 100
        default 100
        help
            Brightness applied once the device receives a valid desired state
            from ThingsBoard. The hardware output stays off until that state
            arrives regardless of this value. This is a hardware default, not
            a credential.

    config KLC_THINGSBOARD_SYNC_TIMEOUT_MS
        int "ThingsBoard state synchronization timeout (ms)"
        range 1000 60000
        default 10000
        help
            Maximum time to wait for an authoritative power and brightness
            state after MQTT connection. If the timeout expires the output
            stays off and the device retries after reconnect backoff.

    config KLC_THINGSBOARD_PROVISION_TIMEOUT_MS
        int "ThingsBoard bootstrap provisioning response timeout (ms)"
        range 5000 60000
        default 20000
        help
            Maximum time to wait for the ThingsBoard /provision/response
            reply during one-shot bootstrap enrollment. This is a separate,
            longer budget than KLC_THINGSBOARD_SYNC_TIMEOUT_MS because
            first-time device creation can take longer than routine state
            sync round trips.

    config KLC_TELEMETRY_PERIOD_MS
        int "Periodic telemetry publish interval (ms)"
        range 1000 3600000
        default 30000
        help
            Interval between periodic health telemetry publishes. Telemetry
            is also published on connect and on every state change. This value
            is not a credential or token.

    menu "ThingsBoard OTA"

        config KLC_OTA_CHUNK_SIZE
            int "Firmware chunk size requested from ThingsBoard (bytes)"
            range 512 16384
            default 4096
            help
                Size of each v2/fw chunk. Larger chunks download faster but
                need more RAM in the MQTT receive path.

        config KLC_OTA_CHUNK_TIMEOUT_MS
            int "Chunk response timeout (ms)"
            range 1000 120000
            default 10000

        config KLC_OTA_CHUNK_RETRIES
            int "Chunk re-requests before the update fails"
            range 1 20
            default 3

        config KLC_OTA_CHECK_PERIOD_MS
            int "Periodic firmware check interval (ms, 0 = disabled)"
            range 0 86400000
            default 3600000
            help
                The device also checks after every ThingsBoard
                synchronization and whenever fw_* shared attributes change.

        config KLC_OTA_REBOOT_DELAY_MS
            int "Delay between image activation and restart (ms)"
            range 500 30000
            default 2000
            help
                Lets the UPDATING telemetry reach ThingsBoard before restart.

        config KLC_OTA_BLINK_PERIOD_MS
            int "Progress blink half period (ms)"
            range 100 10000
            default 1000

        config KLC_OTA_BLINK_BRIGHTNESS_PERCENT
            int "Progress blink brightness (%)"
            range 1 100
            default 100

    endmenu

    choice KLC_WIFI_DEFAULT_MODE
        prompt "Default Wi-Fi start mode"
        default KLC_WIFI_DEFAULT_MODE_APSTA
        help
            Wi-Fi mode used by the network stage (network_manager, TASK-109)
            for a fresh device. With this default, a fresh device starts in
            AP+STA so its portal is immediately reachable. A device with a
            saved credential starts station-only until the bounded fallback
            controller opens the portal, preventing a visible but nonfunctional
            provisioning AP during normal station retries.

        config KLC_WIFI_DEFAULT_MODE_APSTA
            bool "AP+STA (station plus provisioning access point)"
            help
                Start a fresh device in AP+STA mode (T_WIFI_TYPE_CLI_SER). A
                device with a saved credential begins station-only and is
                promoted to AP+STA when the provisioning portal is started.

        config KLC_WIFI_DEFAULT_MODE_CLIENT
            bool "Station-only (client)"
            help
                Start the Wi-Fi manager in station-only mode (T_WIFI_TYPE_
                CLIENT) for hardened production builds. Select this only when
                the device is provisioned out-of-band and never needs the
                portal.
    endchoice

endmenu
```
